## drivers/misc/spi-tty/Kconfig
```kconfig
#
# TTY over spi slave configuration
#

menu "TTY driver over Tegra SPI slave"

config TTY_SPI_SLAVE_MDM6600
	bool "tty over spi slave driver"
	depends on SPI_SLAVE_TEGRA
	default n

endmenu
```

## drivers/misc/vni/Kconfig
```kconfig
#
# Virtual Network Interfaces configuration
#

menu "Motorola Virtual Network Interface driver"

config MOT_VNI_DRIVER
        tristate "Motorola VNI driver"
        default m

endmenu
```

## drivers/net/wireless/bcmdhd/Kconfig
```kconfig
config BCMDHD
	tristate "Broadcom 4329/30 wireless cards support"
	depends on MMC
	---help---
	  This module adds support for wireless adapters based on
	  Broadcom 4329/30 chipset.

	  This driver uses the kernel's wireless extensions subsystem.

	  If you choose to build a module, it'll be called dhd. Say M if
	  unsure.

config BCMDHD_FW_DIR
	depends on BCMDHD
	string "Firmware path"
	default "/system/vendor/firmware"
	---help---
	  Path to the firmware file.

config BCMDHD_NVRAM_DIR
	depends on BCMDHD
	string "NVRAM path"
	default "/system/etc"
	---help---
	  Path to the calibration file.

config BCMDHD_WEXT
	bool "Enable WEXT support"
	select WIRELESS_EXT
	select WEXT_PRIV
	help
	  Enables WEXT support

config DHD_USE_STATIC_BUF
       bool "Enable memory preallocation"
       depends on BCMDHD
       default n
       ---help---
         Use memory preallocated in platform

config DHD_USE_SCHED_SCAN
	bool "Use CFG80211 sched scan"
	depends on BCMDHD && CFG80211
	default n
	---help---
	Use CFG80211 sched scan

config DHD_ENABLE_P2P
	bool "Enable Wifi Direct"
	depends on BCMDHD && CFG80211
	default n
	---help---
	Use Enable Wifi Direct

config BCMDHD_CFG80211
	bool "Enable CFG80211 support"
	depends on CFG80211
	help
	  Enables CFG80211 support

config BCMDHD_NOAPI
	bool "No wireless API"
	help
	  No wireless API is needed

config BCMDHD_WIFI_CONTROL_FUNC
	bool "Use bcmdhd_wlan device"
	depends on BCMDHD
	default n
	---help---
	  Use this option to get various parameters from architecture specific
	  bcmdhd_wlan platform device. Say n if unsure.

config BCMDHD_HW_OOB
	bool "Use out of band interrupt"
	depends on BCMDHD
	default n
	---help---
	  Use out of band interrupt for card interrupt and wake on wireless.

config BCMDHD_CSCAN_ENABLE
	bool "Enable Combo Scan"
	depends on BCMDHD
	default n
	---help---
	Enable Combo Scan

config BCMDHD_INSMOD_NO_FW_LOAD
	bool "Enable delayed firmware load"
	depends on BCMDHD
	default n
	---help---
	Enable delayes firmware

config BCMDHD_CUSTOM_REGULATORY_DOMAIN
	bool "Enable Custom Regulatory Domain"
	depends on BCMDHD
	default y
	---help---
	Use Custom Regulatory Domain set by driver.
```
